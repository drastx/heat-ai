/*
 * heat-ai - Machine learning based whole-house heating and cooling
 * 
 * Copyright (c) 2020 Dragan Stancevic <dragan@stancevic.com>
 * 
 * This file is part of heat-ai.
 * 
 * heat-ai is free software: you can redistribute it and/or modify
 * it under the terms of the GNU Affero General Public License as
 * published by the Free Software Foundation, either version 3 of the
 * License, or (at your option) any later version.
 * 
 * heat-ai is distributed in the hope that it will be useful,
 * but WITHOUT ANY WARRANTY; without even the implied warranty of
 * MERCHANTABILITY or FITNESS FOR A PARTICULAR PURPOSE.  See the
 * GNU Affero General Public License for more details.
 * 
 * You should have received a copy of the GNU Affero General Public License
 * along with heat-ai. If not, see <https://www.gnu.org/licenses/>.
 * 
 * This firmware is intended for:
 *  Arduino Pro Mini ATmega328P 3.3v,8Mhz
 *  with sht3c based temperature/humidity sensor
 */

#include "LowPower.h"
#include "SparkFun_SHTC3.h"

/* arduino sensor firmware version */
#define FW_VER "v1.0"

/* i2c wire speed */
#define WIRE_CLK_SPD 400000
/* serial USB speed */
#define SERIAL_SPEED 115200

/* sensor connection */
static SHTC3 s;

/* types of transmissions we provide to the host; there is
 * a delay after transmitted to allow hardware to finish */

/* SENSOR INFO: transmitted on boot
 * "I:BOOT:F:ID:VERSION" for Fahrenheit - (ONLY ONE SUPPORTED ATM)
 * "I:BOOT:C:ID:VERSION" for Celsius */
#define SEND_INFO(sensor) \
	do { \
		Serial.print("I:BOOT:F:"); \
		Serial.print(sensor.ID); \
		Serial.print(":"); \
		Serial.print(FW_VER); \		
		Serial.println(); \
		delay(10); \
	} while(0)

/* SENSOR DATA: transmitted about every half a minute
 * "D:ID:TEMPERATURE:HUMIDITY" */
#define SEND_DATA(sensor, temperature, humidity) \
	do { \
		Serial.print("D:"); \
		Serial.print(sensor.ID); \
		Serial.print(":"); \
		Serial.print(temperature); \
		Serial.print(":"); \
		Serial.print(humidity); \
		Serial.println(); \
 		delay(10); \
} while(0)

/* SENSOR ERROR: transmitted every time we have an error talking to the sensor
 * "E:FUNCTION:LINE:STATUS:passIDcrc:VALUE:passTcrc:VALUE:passRHcrc:VALUE */
#define SEND_ERROR(retval, sensor, function, line) \
	do { \
		Serial.print("E:"); \
		Serial.print(function); \
		Serial.print(":"); \
		Serial.print(line); \
		Serial.print(":"); \
		Serial.print(retval); \
		Serial.print(":passIDcrc:"); \
		Serial.print(sensor.passIDcrc); \
		Serial.print(":passTcrc:"); \
		Serial.print(sensor.passTcrc); \
		Serial.print(":passRHcrc:"); \
		Serial.print(sensor.passRHcrc); \
		Serial.println(); \
		delay(10); \
	} while(0)

/* latest temperature and humidity */
static float temperature, humidity;

/* is everything working */
volatile bool running = false;

/* arduino setup function */
void setup() {
	SHTC3_Status_TypeDef ret;
	/* setup the serial connection to the host computer */
	Serial.begin(SERIAL_SPEED);
	while (!Serial);
	/* configure wire speed to the sensor */
	Wire.setClock(WIRE_CLK_SPD);
	/* setup the sensor */
	ret = s.begin();
	if (ret == SHTC3_Status_Nominal && s.passIDcrc) {
		running = true;
		SEND_INFO(s);
	} else {
		running = false;
		SEND_ERROR(ret, s, __func__, __LINE__);
	}
}

/* Turn off features to conserve power, sleep for approximately half
 * a minute between each reading. We do this to conserve power and
 * decrease the amount of heat generated by the arduino cpu */
static inline void go_low_power() {
	LowPower.powerDown(SLEEP_8S, ADC_OFF, BOD_OFF);
	LowPower.powerDown(SLEEP_8S, ADC_OFF, BOD_OFF);
	LowPower.powerDown(SLEEP_8S, ADC_OFF, BOD_OFF);
	LowPower.powerDown(SLEEP_8S, ADC_OFF, BOD_OFF);
}

/* arduino main loop function */
void loop() {
	SHTC3_Status_TypeDef ret;
	if (running == true) {
		/* take a sensor measurement */
		ret = s.update();
		if (ret == SHTC3_Status_Nominal) {
			humidity = s.toPercent();    
			temperature = s.toDegF();
			SEND_DATA(s, temperature, humidity);
		} else {
			/* if something goes wrong we send ourselves into a low power
			 * loop, in the future we should reset the arduino here */
			running = false;
			SEND_ERROR(ret, s, __func__, __LINE__);
		}
	}
	go_low_power();
}
